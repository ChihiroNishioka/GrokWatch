## firmware/main/Kconfig.projbuild
```kconfig
menu "GrokWatch"

config GROKWATCH_WIFI_SSID
    string "Wi-Fi SSID"
    default ""

config GROKWATCH_WIFI_PASSWORD
    string "Wi-Fi password"
    default ""

config GROKWATCH_GATEWAY_HOST
    string "Gateway host"
    default ""

config GROKWATCH_GATEWAY_PORT
    int "Gateway port"
    range 1 65535
    default 8765

config GROKWATCH_DEVICE_TOKEN
    string "Device token"
    default ""

config GROKWATCH_WAKE_WORD
    bool "Enable Hi Grok wake word (requires gateway support)"
    default y

endmenu
```

## firmware/sdkconfig.defaults
```kconfig
CONFIG_ESPTOOLPY_FLASHSIZE_16MB=y
CONFIG_PARTITION_TABLE_CUSTOM=y
CONFIG_PARTITION_TABLE_CUSTOM_FILENAME="partitions.csv"

CONFIG_SPIRAM=y
CONFIG_SPIRAM_MODE_OCT=y
CONFIG_SPIRAM_SPEED_80M=y
CONFIG_SPIRAM_USE_MALLOC=y

CONFIG_FREERTOS_HZ=1000
CONFIG_ESP_WIFI_NVS_ENABLED=n
CONFIG_ESP_PHY_CALIBRATION_AND_DATA_STORAGE=n
CONFIG_BOOTLOADER_LOG_LEVEL_ERROR=y
CONFIG_LOG_DEFAULT_LEVEL_ERROR=y
CONFIG_LOG_MAXIMUM_LEVEL_INFO=y
```
